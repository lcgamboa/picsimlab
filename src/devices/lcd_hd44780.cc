/* ########################################################################

   PICsimLab - PIC laboratory simulator

   ########################################################################

   Copyright (c) : 2010-2022  Luis Claudio Gambôa Lopes

   This program is free software; you can redistribute it and/or modify
   it under the terms of the GNU General Public License as published by
   the Free Software Foundation; either version 2, or (at your option)
   any later version.

   This program is distributed in the hope that it will be useful,
   but WITHOUT ANY WARRANTY; without even the implied warranty of
   MERCHANTABILITY or FITNESS FOR A PARTICULAR PURPOSE.  See the
   GNU General Public License for more details.

   You should have received a copy of the GNU General Public License
   along with this program; if not, write to the Free Software
   Foundation, Inc., 675 Mass Ave, Cambridge, MA 02139, USA.

   For e-mail suggestions :  lcgamboa@yahoo.com
   ######################################################################## */

#include "lcd_hd44780.h"
#include <stdio.h>

//#define _DEBUG

const unsigned char LCDfont[224][5] = {
    {0x00, 0x00, 0x00, 0x00, 0x00},  // (space)
    {0x00, 0x00, 0x5F, 0x00, 0x00},  // !
    {0x00, 0x07, 0x00, 0x07, 0x00},  // "
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    {0xFF, 0xFF, 0xFF, 0xFF, 0xFF},
};

void lcd_cmd(lcd_t* lcd, char cmd) {
    int i;

    // switch betwwen 8 or 4 bits communication
    if (!(lcd->flags & L_DL)) {
        if (lcd->bc) {
            lcd->bc = 0;
            cmd = lcd->buff | (((unsigned char)cmd) >> 4);
        } else {
            lcd->bc = 1;
            lcd->buff = cmd & 0xF0;
            return;
        }
    }
#ifdef _DEBUG
    printf("LCD cmd=%#04X\n", (unsigned char)cmd);
#endif

    // Set DDRAM address
    if (cmd & 0x80) {
        i = cmd & 0x7F;

        if (i < 40) {
            lcd->addr_counter = i;
        } else {
            lcd->addr_counter = i - 24;
        }

        if (lcd->addr_counter >= DDRMAX)
            lcd->addr_counter = 0;
        lcd->addr_mode = LCD_ADDR_DDRAM;

        return;
    }

    // Set CGRAM address
    if (cmd & 0x40) {
        lcd->addr_counter = cmd & 0x3F;
        lcd->addr_mode = LCD_ADDR_CGRAM;
        return;
    }

    // Function set
    if (cmd & 0x20) {
        // Sets interface data length
        if (cmd & 0x10) {
            lcd->flags |= L_DL;
        } else {
            lcd->flags &= ~L_DL;
        }

        // Sets number of display line
        if (cmd & 0x08) {
            lcd->flags |= L_NLI;
        } else {
            lcd->flags &= ~L_NLI;
        }

        // Sets character font
        if (cmd & 0x04) {
            lcd->flags |= L_FNT;
        } else {
            lcd->flags &= ~L_FNT;
        }

        return;
    }

    // Cursor/display shift
    if (cmd & 0x10) {
        // Sets shift direction
        if (cmd & 0x04) {
            lcd->flags |= L_LR;
        } else {
            lcd->flags &= ~L_LR;
        }

        // Sets cursor-move or display-shift
        if (cmd & 0x08) {
            // display shift
            lcd->flags |= L_CD;

            if (lcd->flags & L_LR) {
                lcd->shift++;
                if (lcd->shift > 40)
                    lcd->shift = lcd->shift - 40;
            } else {
                lcd->shift--;
                if (lcd->shift < -40)
                    lcd->shift = lcd->shift + 40;
            }
        } else {
            // cursor move
            lcd->flags &= ~L_CD;

            if (lcd->flags & L_LR)
                lcd->addr_counter++;
            else
                lcd->addr_counter--;
        }

        lcd->update = 1;
        return;
    }

    // Display On/Off control
    if (cmd & 0x08) {
        // Sets On/Off of all display
        if (cmd & 0x04) {
            lcd->flags |= L_DON;
        } else {
            lcd->flags &= ~L_DON;
        }

        // Sets cursor On/Off
        if (cmd & 0x02) {
            lcd->flags |= L_CON;
        } else {
            lcd->flags &= ~L_CON;
        }

        // Set blink of cursor position character
        if (cmd & 0x01) {
            lcd->flags |= L_CBL;
        } else {
            lcd->flags &= ~L_CBL;
        }

        lcd->update = 1;
        return;
    }

    // Entry mode set
    if (cmd & 0x04) {
        // Sets cursor move direction
        if (cmd & 0x02) {
            lcd->flags |= L_DID;
        } else {
            lcd->flags &= ~L_DID;
        }

        // specifies to shift the display
        if (cmd & 0x01) {
            lcd->flags |= L_DSH;
        } else {
            lcd->flags &= ~L_DSH;
        }

        return;
    }

    // Cursor home
    if (cmd & 0x02) {
        lcd->addr_counter = 0;
        lcd->shift = 0;
        lcd->update = 1;
        return;
    }

    // Clear display
    if (cmd & 0x01) {
        memset(lcd->ddram_char, ' ', DDRMAX);
        lcd->addr_counter = 0;
        lcd->shift = 0;
        lcd->flags |= L_DID;
        lcd->update = 1;
        return;
    }
}

void lcd_data(lcd_t* lcd, char data) {
    int j;

    if (!(lcd->flags & L_DON)) {
        lcd_cmd(lcd, data);
        return;
    }

    // switch betwwen 8 or 4 bits communication
    if (!(lcd->flags & L_DL)) {
        if (lcd->bc) {
            lcd->bc = 0;
            data = lcd->buff | (((unsigned char)data) >> 4);
        } else {
            lcd->bc = 1;
            lcd->buff = data & 0xF0;
            return;
        }
    }

    /*
    if(data < 0x20)
    {
      printf("LCD dat=ERROR!\n");
      return;
    }
     */

#ifdef _DEBUG
    printf("LCD dat=%#04X  (%c)\n", (unsigned char)data, data);
#endif
    if (lcd->addr_mode == LCD_ADDR_DDRAM) {
        lcd->ddram_char[lcd->addr_counter] = data;

        if (lcd->flags & L_DID) {
            lcd->addr_counter++;
            if (lcd->addr_counter >= DDRMAX)
                lcd->addr_counter = 0;
            if (lcd->flags & L_DSH) {
                lcd->shift--;
                if (lcd->shift < -40)
                    lcd->shift = lcd->shift + 40;
            }
        } else {
            lcd->addr_counter--;
            if (lcd->addr_counter >= DDRMAX)
                lcd->addr_counter = DDRMAX - 1;
            if (lcd->flags & L_DSH) {
                lcd->shift++;
                if (lcd->shift > 40)
                    lcd->shift = lcd->shift - 40;
            }
        }

        lcd->update = 1;
    } else {
        lcd->cgram_char[lcd->addr_counter >> 3] = data;
        for (j = 0; j < 5; j++) {
            if ((data & (0x01 << (4 - j))) > 0) {
                lcd->cgram[lcd->addr_counter >> 3][j] |= (0x01 << (lcd->addr_counter & 0x07));
            } else {
                lcd->cgram[lcd->addr_counter >> 3][j] &= ~(0x01 << (lcd->addr_counter & 0x07));
            }
        }
        if (lcd->flags & L_DID) {
            lcd->addr_counter++;
            if (lcd->addr_counter >= 64)
                lcd->addr_counter = 0;
        } else {
            lcd->addr_counter--;
            if (lcd->addr_counter >= 64)
                lcd->addr_counter = 63;
        }
        lcd->update = 1;
    }
}

unsigned char lcd_read_busyf_acounter(lcd_t* lcd) {
    // busy flag aways 0
    unsigned char status = (0x7F & lcd->addr_counter);

    // switch betwwen 8 or 4 bits communication
    if (!(lcd->flags & L_DL)) {
        if (lcd->bc) {
            lcd->bc = 0;
            status = (0x0F & status) << 4;
        } else {
            lcd->bc = 1;
            // status = status & 0xF0;
        }
    }
#ifdef _DEBUG
    printf("LCD read flags=0x%02X bc=%i \n", (unsigned char)status, lcd->bc);
#endif
    return status;
}

char lcd_read_data(lcd_t* lcd) {
    char ret;

    if (lcd->addr_mode == LCD_ADDR_DDRAM) {
        ret = lcd->ddram_char[lcd->addr_counter];
        if (lcd->bc) {
            if (lcd->flags & L_DID) {
                lcd->addr_counter++;
                if (lcd->addr_counter >= DDRMAX)
                    lcd->addr_counter = 0;
            } else {
                lcd->addr_counter--;
                if (lcd->addr_counter >= DDRMAX)
                    lcd->addr_counter = DDRMAX - 1;
            }
        }
    } else {
        ret = lcd->cgram_char[lcd->addr_counter];
        if (lcd->bc) {
            if (lcd->flags & L_DID) {
                lcd->addr_counter++;
                if (lcd->addr_counter >= 64)
                    lcd->addr_counter = 0;
            } else {
                lcd->addr_counter--;
                if (lcd->addr_counter >= 64)
                    lcd->addr_counter = 63;
            }
        }
    }

    // switch betwwen 8 or 4 bits communication
    if (!(lcd->flags & L_DL)) {
        if (lcd->bc) {
            lcd->bc = 0;
            ret = (0x0F & ret) << 4;
        } else {
            lcd->bc = 1;
            // ret = ret & 0xF0;
        }
    }

#ifdef _DEBUG
    printf("LCD read data=0x%02X  bc=%i\n", (unsigned char)ret, lcd->bc);
#endif

    return ret;
}

void lcd_rst(lcd_t* lcd) {
    int i, j;

#ifdef _DEBUG
    printf("LCD rst--------------------------\n");
#endif

    for (i = 0; i < 8; i++) {
        for (j = 0; j < 5; j++) {
            lcd->cgram[i][j] = 0;
        }
    }

    memset(lcd->ddram_char, ' ', DDRMAX);
    memset(lcd->cgram_char, 0, 64);

    lcd->addr_counter = 0;
    lcd->addr_mode = LCD_ADDR_DDRAM;
    lcd->update = 1;
    lcd->bc = 0;

    lcd->blink = 0;
    lcd->blinkc = 0;
    lcd->shift = 0;
    lcd->flags = L_DL | L_DID;
    return;
}

void lcd_init(lcd_t* lcd, unsigned char cnum, unsigned char lnum) {
    if ((cnum > 15) && (cnum <= 20))
        lcd->cnum = cnum;
    else
        lcd->cnum = 16;

    if ((lnum > 0) && (lnum <= 4))
        lcd->lnum = lnum;
    else
        lcd->lnum = 2;
    lcd->update = 1;
}

void lcd_on(lcd_t* lcd, int onoff) {
    if (onoff == 1) {
        lcd->flags = 0;
    };
    lcd_rst(lcd);
}

void lcd_blink(lcd_t* lcd) {
    if ((lcd->flags & L_CON) && (lcd->flags & L_CBL)) {
        lcd->blinkc++;
        if (lcd->blinkc > 4) {
            lcd->blinkc = 0;
            lcd->update = 1;
            lcd->blink ^= 1;
        }
    } else
        lcd->blink = 0;
}

void lcd_draw(lcd_t* lcd, CCanvas* canvas, int x1, int y1, int w1, int h1, int picpwr) {
    int l, c, x, y;
    int loff = 0;
    int w;

    if (lcd->cnum == 16)
        w = w1;
    else
        w = (int)(w1 * 1.25);

    if (lcd->lnum == 2)
        canvas->Rectangle(1, x1, y1, w, h1);
    else
        canvas->Rectangle(1, x1, y1, w, (h1 * 2) - 14);
    lcd->update = 0;

    for (l = 0; l < lcd->lnum; l++) {
        switch (l) {
            case 0:
                loff = 0;
                break;
            case 1:
                loff = 40;
                break;
            case 2:
                loff = lcd->cnum;
                break;
            case 3:
                loff = 40 + lcd->cnum;
                break;
        }
        for (c = 0; c < lcd->cnum; c++) {
            for (x = 0; x < 5; x++) {
                for (y = 0; y < 8; y++) {
                    int cs = c - lcd->shift;
                    if (cs < 0)
                        cs = 40 + (cs % 40);
                    if (cs >= 40)
                        cs = cs % 40;
                    char ram;
                    int fp = ((unsigned char)lcd->ddram_char[(cs + loff) % DDRMAX]);

                    if (fp >= 0x20) {
                        ram = LCDfont[fp - 0x20][x];
                    } else {
                        ram = lcd->cgram[fp & 0x07][x];
                    }
                    if ((ram & (0x01 << y)) && (lcd->flags & L_DON)) {
                        canvas->SetFgColor(0, 35, 0);
                        canvas->SetColor(0, 35, 0);
                    } else {
                        canvas->SetFgColor(0, 90 * picpwr + 35, 0);
                        canvas->SetColor(0, 90 * picpwr + 35, 0);
                    }
                    //          canvas.Rectangle (1, output[i].x1+12+(x*4)+(c*22), output[i].y1+8+(y*4)+(l*38), 4,4 );
                    canvas->Rectangle(1, x1 + 2 + (x * 4) + (c * 23), y1 + 10 + (y * 4) + (l * 35), 4, 4);
                }
            }
        }
    }

    // cursor
    if ((lcd->flags & L_DON) && (lcd->flags & L_CON)) {
        if (lcd->addr_counter < 40) {
            l = 0;
            c = (lcd->addr_counter + lcd->shift);
        } else {
            l = 1;
            c = lcd->addr_counter - 40 + lcd->shift;
        }

        if (c < 0)
            c = 40 + (c % 40);
        if (c >= 40)
            c = c % 40;

        if ((c >= 0) && (c < lcd->cnum))  // draw only visible columns
        {
            canvas->SetFgColor(0, 35, 0);
            canvas->SetColor(0, 35, 0);

            if (lcd->blink)
                canvas->Rectangle(1, x1 + 2 + (c * 23), y1 + 10 + (l * 35), 20, 32);
            else
                canvas->Rectangle(1, x1 + 2 + (c * 23), y1 + 38 + (l * 35), 20, 4);
        }
    }
}
